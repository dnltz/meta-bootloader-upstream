## conf/layer.conf
```bitbake
# We have a conf and classes directory, append to BBPATH
BBPATH .= ":${LAYERDIR}"

# We have a recipes directory containing .bb and .bbappend files, add to BBFILES
BBFILES += "${LAYERDIR}/recipes-*/*/*.bb \
            ${LAYERDIR}/recipes-*/*/*.bbappend"

BBFILE_COLLECTIONS += "meta-bootloader-upstream"
BBFILE_PATTERN_meta-bootloader-upstream := "^${LAYERDIR}/"
BBFILE_PRIORITY_meta-bootloader-upstream = "20"
LAYERVERSION_meta-bootloader-upstream = "2"
LAYERDEPENDS_meta-bootloader-upstream = "core"
LAYERSERIES_COMPAT_meta-bootloader-upstream = "kirkstone scarthgap styhead"
```
